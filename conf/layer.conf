## conf/layer.conf
```bitbake
# We have a conf and classes directory, add to BBPATH
BBPATH .= ":${LAYERDIR}"

# We have a packages directory, add to BBFILES
BBFILES += "${LAYERDIR}/recipes-*/*/*.bb \
            ${LAYERDIR}/recipes-*/*/*.bbappend"

BBFILE_COLLECTIONS += "meta-klexdash"
BBFILE_PATTERN_meta-klexdash = "^${LAYERDIR}/"
BBFILE_PRIORITY_meta-klexdash = "9"
LAYERSERIES_COMPAT_meta-klexdash = "hardknott"
```
